## conf/distro/oe-measured.conf
```bitbake
DISTRO = "oe-measured"
DISTROOVERRIDES = "tpm:txt"
DISTRO_FEATURES_append = " ima"
```

## conf/distro/oe-tpm.conf
```bitbake
DISTRO = "oe-tpm"
DISTROOVERRIDES = "tpm:tboot"

DISTRO_FEATURES_append = " tpm tboot "
```

## conf/layer.conf
```bitbake
BBPATH .= ":${LAYERDIR}"

BBFILES += "${LAYERDIR}/recipes-*/*/*.bb \
            ${LAYERDIR}/recipes-*/*/*.bbappend \
            "

# Add layer-specific bbappends only when the relevant layer is available
BBFILES += "${@' '.join('${LAYERDIR}/%s/recipes-*/*/*.bbappend' % layer \
               for layer in BBFILE_COLLECTIONS.split())}"

BBMASK += "${@'recipes-tpm/[^/]*/.*_git' if d.getVar('BB_NO_NETWORK') == '1' else ''}"

BBFILE_COLLECTIONS += "measured"
BBFILE_PATTERN_measured := "^${LAYERDIR}/"
BBFILE_PRIORITY_measured = "5"

LAYERDEPENDS_measured = "core"
LAYERSERIES_COMPAT_measured = "sumo thud"

# override security flags to have the packages work
require conf/distro/include/measured_security_flags.inc
```

## conf/machine/intel-corei7-64-vpro.conf
```bitbake
#@TYPE: Machine
#@NAME: intel-corei7-64-vpro
#@DESCRIPTION: Machine configuration for 64 bit Intel Core i7 CPU with vpro.

require conf/machine/intel-corei7-64.conf

MACHINE_FEATURES += "tpm"
MACHINE_FEATURES += "txt"
```

## conf/machine/nuc-vpro.conf
```bitbake
#@TYPE: Machine
#@NAME: chiefriver + vpro
#@WEBTITLE: Intel Next Unit of Computing (NUC) Model: DC53427HYE
#@DESCRIPTION: Machine configuration for Intel NUC model DC53427HYE

require conf/machine/nuc.conf

MACHINE_FEATURES += "tpm"
MACHINE_FEATURES += "txt"
```

## conf/machine/qemux86-64-tpm-tis.conf
```bitbake
#@TYPE: Machine
#@NAME: qemux86-64-tpm-tis
#@DESCRIPTION: Machine configuration adding TPM TIS support

require conf/machine/qemux86-64.conf

MACHINE_FEATURES += "tpm"

PREFERRED_PROVIDER_virtual/kernel = "linux-yocto"
KMACHINE_qemux86-64-tpm-tis = "qemux86-64"
```

## conf/machine/qemux86-64-tpm.conf
```bitbake
#@TYPE: Machine
#@NAME: qemux86-64-tpm
#@DESCRIPTION: Machine adding TPM TIS support to the base qemux86-64 machine.

require conf/machine/qemux86-64.conf

MACHINE_FEATURES += "tpm"

PREFERRED_PROVIDER_virtual/kernel = "linux-yocto"
KMACHINE_qemux86-64-tpm = "qemux86-64"
```

## conf/machine/qemux86-64-tpm2.conf
```bitbake
#@TYPE: Machine
#@NAME: qemux86-64-tpm2-tis
#@DESCRIPTION: Machine adding TPM2 support to the base qemux86-64 machine.

require conf/machine/qemux86-64.conf

MACHINE_FEATURES += "tpm2-tis"

PREFERRED_PROVIDER_virtual/kernel = "linux-yocto"
KMACHINE_qemux86-64-tpm2 = "qemux86-64"
```
